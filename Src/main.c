/****************************************************************

  * 描述        : 四相磁悬浮平面电机电流环驱动程序.
	* 作者        : 杨晓生 | YangXiaoSheng 2019/11/20
	* 作者联系方式 : 943376962@qq.com
  ******************************************************************************
  * @attention 驱动器状态指示
 ***********************************************************驱动板LED指示状态***********-****************************************************************
 
						          |-------------------------------------------------------------------------------------------------------------------------------------------|
											|   		BoardState_LED 	  	|	  AxisX_LED 		|    AxisY_LED	  |  CoilA_LED	| CoilB_LED	| CoilC_LED	 | CoilD_LED	 		|  ADC_ALARM_LED		|
						----------|-------------------------------------------------------------------------------------------------------------------------------------------|
											| 					off							|		on（地址为X轴)	|	 off（地址为X轴) |			off					off					 off				 off			 		|		  	off					|
							初始化 	|-------------------------------------------------------------------------------------------------------------------------------------------|
	*********					 	| 					off							|	 off（地址为Y轴) |  on（地址为Y轴)	|   	off					off					 off				 off			 		|				off				 	|
	*正常运行* ----------|-------------------------------------------------------------------------------------------------------------------------------------------|
	*********	就绪状态		|					慢速闪烁						|				X					|					X				|			off					off					 off				 off			 		|				off				 	|
						----------|-------------------------------------------------------------------------------------------------------------------------------------------|
						运行状态		|					快速闪烁						|				X					|					X				| X相有电流输出，CoilX_LED就on，无电流输出的相LED则off			|				off					|
	--------------------|-------------------------------------------------------------------------------------------------------------------------------------------|
						过流		 	|						off							|				X					|					X				|			X相过流，CoilX_LED就快速闪烁，其余的off							|				off					|
						----------|-------------------------------------------------------------------------------------------------------------------------------------------|
						开路		 	|						off							|				X					|					X				|	X相开路，CoilX_LED快速闪烁两次（滴滴~滴滴）,其余的off 		|  			off				 	|
	*********	----------|-------------------------------------------------------------------------------------------------------------------------------------------|
	*错误状态*通讯错误		|快速闪烁两次（滴滴~滴滴）		|				X					|					X				|			off					off					 off				 off			 		|				off				 	|
	*********	----------|-------------------------------------------------------------------------------------------------------------------------------------------|
								 -软件|快速闪烁三次（滴滴滴~滴滴滴)	|				X					|					X				|			off					off					 off				 off			 		|				off				 	|
					 ADC错误	  |-------------------------------------------------------------------------------------------------------------------------------------------|
								 -硬件|快速闪烁三次（滴滴滴~滴滴滴)	|				X				  |					X				|			off					off					 off				 off			 		|				on				 	|
	----------------------------------------------------------------------------------------------------------------------------------------------------------------|	
	Note: X表示为LED不做任何操作，保持初始化时候的状态
				所有错误状态一旦出现，电流板强制线圈电流为0，但是驱动器的错误状态可由握手命令去除掉，握手之后板子状态回归为standby.
****************************************************************/

#include "main.h"

uint8_t Flag_for_FristTime_ErrorReport=0;	//发送错误信号的标志位
uint8_t Flag_for_HandShake=0;							//发送握手信号的标志位
uint8_t temp;
int main(void)
{
	HAL_Init();
	SystemClock_Config();
	MX_GPIO_Init();
	MX_TIM1_Init();						//PWM Output
	MX_TIM8_Init();						//PWM Output
	MX_DMA_Init();						//DMA初始化必须在I2S初始化之前!!!!
	MX_I2S2_Init();
	ADS8674_Init();
	Current_Controller_Init();
	MX_CAN2_Init();
	MX_DAC_Init();
	MX_USART2_UART_Init();
	MX_USART3_UART_Init();
	PVD_Init();								//掉电检测程序初始化 在掉电的瞬间把所有信号关掉
	MX_TIM2_Init();						//电流环控制的计算函数放在TIM2的中断中完成--50kHz频率
	user_Board_Initial();			//该函数必须放在所有外设初始化完成之后!!!
  while (1)
	{
		/********主函数里面执行向dSpace报告错误和向dSpace握手的任务******/
		/*错误发生的第一时间先发送一次错误报告，之后的每隔1000mS发送一次错误报告*/
		if((OverCurrent_Err==Board_State) || (OpenCircuit_Err==Board_State) || (CanBus_Comm_Err==Board_State)|| \
			 (ADC_Trans_Err_Soft==Board_State)||(ADC_Trans_Err_Hard==Board_State))
		{
			temp=Board_State;	
			if(!Flag_for_FristTime_ErrorReport)	//确定是第一次执行向dSpace的报错任务
			{
					Error_Report_Tx_Fcn();
					Flag_for_FristTime_ErrorReport=1;
			}	
			else
			{
					Error_Report_Tx_Fcn();
					HAL_Delay(999-Board_Number);
			}
		}
		/****接收到请求握手命令，发送握手数据帧*****/
	if(1==Flag_for_HandShake)	
		{
			Hand_Shake_Tx_Fcn();
			Flag_for_HandShake=0;		//标志位复位
		}	
  }
}

/****************************END OF FILE****/
